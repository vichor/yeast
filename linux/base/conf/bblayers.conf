## linux/base/conf/bblayers.conf
```bitbake
# LAYER_CONF_VERSION is increased each time build/conf/bblayers.conf
# changes incompatibly
LCONF_VERSION = "6"

BBPATH = "${TOPDIR}"
BBFILES ?= ""

BBLAYERS ?= " \
  <PATH>/meta \
  <PATH>/meta-yocto \
  <PATH>/meta-yocto-bsp \
  <PATH>/meta-raspberrypi \
  "
BBLAYERS_NON_REMOVABLE ?= " \
  <PATH>/meta \
  <PATH>/meta-yocto \
  "
```
